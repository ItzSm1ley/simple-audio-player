#include <SPI.h>
#include <Wire.h>
#include <Adafruit_GFX.h>
#include <Adafruit_SSD1306.h>

#define SCREEN_WIDTH 128 // OLED display width, in pixels
#define SCREEN_HEIGHT 64 // OLED display height, in pixels

// Declaration for an SSD1306 display connected to I2C (SDA, SCL pins)
#define OLED_RESET     -1 // Reset pin # (or -1 if sharing Arduino reset pin)
#define SCREEN_ADDRESS 0x3C // 0x3C for 128x64, change to 0x3D if needed
Adafruit_SSD1306 display(SCREEN_WIDTH, SCREEN_HEIGHT, &Wire, OLED_RESET);

byte commandBytes[10] = {0x7E, 0xFF, 0x06, 0x00, 0x00, 0x00, 0x00, 0x00, 0x00, 0xEF};

// Variables
// Buttons
const int menuPin = 7;
const int rightPin = 5;
const int leftPin = 9;

// DFPlayer
int song = 1;
int playlist = 1;
int volume = 25;

// Menu
int order = 1;

// 'play_menu', 128x64px
const unsigned char epd_bitmap_play_menu [] PROGMEM = {
	0x00, 0x00, 0x00, 0x00, 0x00, 0x00, 0x00, 0x00, 0x00, 0x00, 0x00, 0x00, 0x00, 0x00, 0x00, 0x00, 
	0x00, 0x00, 0x00, 0x40, 0x00, 0x00, 0x00, 0x00, 0x00, 0x00, 0x00, 0x00, 0x00, 0x00, 0x00, 0x00, 
	0x00, 0x00, 0x00, 0x00, 0x00, 0x00, 0x00, 0x00, 0x00, 0x00, 0x00, 0x00, 0x00, 0x00, 0x00, 0x00, 
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	0x00, 0x00, 0x00, 0x40, 0x00, 0x00, 0x00, 0x00, 0x00, 0x00, 0x00, 0x00, 0x00, 0x00, 0x00, 0x00
};

// 'playlist_menu', 128x64px
const unsigned char epd_bitmap_playlist_menu [] PROGMEM = {
	0x00, 0x00, 0x00, 0x00, 0x00, 0x00, 0x00, 0x00, 0x00, 0x00, 0x00, 0x00, 0x00, 0x00, 0x00, 0x00, 
	0x00, 0x00, 0x00, 0x40, 0x00, 0x00, 0x00, 0x00, 0x00, 0x00, 0x00, 0x00, 0x00, 0x00, 0x00, 0x00, 
	0x00, 0x00, 0x00, 0x00, 0x00, 0x00, 0x00, 0x00, 0x00, 0x00, 0x00, 0x00, 0x00, 0x00, 0x00, 0x00, 
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	0x00, 0x00, 0x00, 0x40, 0x00, 0x00, 0x00, 0x00, 0x00, 0x00, 0x00, 0x00, 0x00, 0x00, 0x00, 0x00
};

// 'volume_menu', 128x64px
const unsigned char epd_bitmap_volume_menu [] PROGMEM = {
	0x00, 0x00, 0x00, 0x00, 0x00, 0x00, 0x00, 0x00, 0x00, 0x00, 0x00, 0x00, 0x00, 0x00, 0x00, 0x00, 
	0x00, 0x00, 0x00, 0x40, 0x00, 0x00, 0x00, 0x00, 0x00, 0x00, 0x00, 0x00, 0x00, 0x00, 0x00, 0x00, 
	0x00, 0x00, 0x00, 0x00, 0x00, 0x00, 0x00, 0x00, 0x00, 0x00, 0x00, 0x00, 0x00, 0x00, 0x00, 0x00, 
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	0x00, 0x00, 0x00, 0x40, 0x00, 0x00, 0x00, 0x00, 0x00, 0x00, 0x00, 0x00, 0x00, 0x00, 0x00, 0x00
};

void setup() {
	// Change to 9600 (because my Nano was broken)
  Serial.begin(38400);

  pinMode(menuPin, INPUT_PULLUP);
	pinMode(rightPin, INPUT_PULLUP);
	pinMode(leftPin, INPUT_PULLUP);

  // Initialize the OLED display
  if(!display.begin(SSD1306_SWITCHCAPVCC, SCREEN_ADDRESS)) {
    Serial.println(F("SSD1306 allocation failed"));
    for(;;); // Don't proceed, loop forever
  }
  display.clearDisplay();
  playMenu();
  display.display();

	// Little delay to make sure the SD Card is detected	
	delay(1000);

	// Chooses folder / song
	sendDFPlayerCommand(0x0F, playlist, song); 
	// Chooses volume
	sendDFPlayerCommand(0x06, 0x00, volume);
}

void loop() {

  // Read the state of the button
  int menuState = digitalRead(menuPin);
	int rightState = digitalRead(rightPin);
	int leftState = digitalRead(leftPin);

  if (menuState == LOW) {
    nextMenu();
  }
	if (rightState == LOW) {
		rightMenu();
	}
	if (leftState == LOW) {
		leftMenu();
	}

}

void nextMenu() {
  order += 1;
  if (order > 3) {
    order = 1; // Loop back to the first menu
  }
	updateMenu();

  // Debounce
  delay(20);
}

void updateMenu() {
	if (order == 1) {
    playMenu();
  } else if (order == 2) {
    playlistMenu();
  } else if (order == 3) {
    volumeMenu();
  }
}

void rightMenu() {
	if (order == 1) {
		song += 1;
		sendDFPlayerCommand(0x0F, playlist, song); 
  } else if (order == 2) {
		playlist += 1;
		song = 1;
		sendDFPlayerCommand(0x0F, playlist, song); 

  } else if (order == 3) {
    if (volume < 30) {
			volume += 1;
			sendDFPlayerCommand(0x06, 0x00, volume); 
		};
  }
	// Updates display
	updateMenu();

	// Debounce
  delay(20);
}

void leftMenu() {
	if (order == 1) {
    if (song > 1) {
    	song -= 1;
			sendDFPlayerCommand(0x0F, playlist, song); 
		}
  } else if (order == 2) {
    if (playlist > 1) {
    	playlist -= 1;
			song = 1;
			sendDFPlayerCommand(0x0F, playlist, song); 
		}
  } else if (order == 3) {
    if (volume > 0) {
			volume -= 1;
			sendDFPlayerCommand(0x06, 0x00, volume);
		};
  }
	// Updates display
	updateMenu();

	// Debounce
  delay(20);
}

void playMenu() {
  display.clearDisplay();
  display.drawBitmap(0, 0, epd_bitmap_play_menu, 128, 64, WHITE);
  display.setTextSize(2);
  display.setTextColor(SSD1306_WHITE);
  display.setCursor(32, 3);
  display.print(F("Song"));
  display.fillTriangle(32, 38, 46, 32, 46, 44, SSD1306_WHITE);
  display.fillTriangle(121, 38, 107, 32, 107, 44, SSD1306_WHITE);
  display.setCursor(60, 32);
	// Display formatting
	if (song < 10) {
		display.print("00");
	} else if (song < 100) {
		display.print("0");
	}
  display.println(song);
  display.display();
}

void playlistMenu() {
  display.clearDisplay();
  display.drawBitmap(0, 0, epd_bitmap_playlist_menu, 128, 64, WHITE);
  display.setTextSize(2);
  display.setTextColor(SSD1306_WHITE);
  display.setCursor(32, 3);
  display.print(F("Playlist"));
  display.fillTriangle(32, 38, 46, 32, 46, 44, SSD1306_WHITE);
  display.fillTriangle(121, 38, 107, 32, 107, 44, SSD1306_WHITE);
  display.setCursor(66, 32);
	// Display formatting
	if (playlist < 10) {
		display.print("0");
	}
  display.println(playlist);
  display.display();
}

void volumeMenu() {
  display.clearDisplay();
  display.drawBitmap(0, 0, epd_bitmap_volume_menu, 128, 64, WHITE);
  display.setTextSize(2);
  display.setTextColor(SSD1306_WHITE);
  display.setCursor(32, 3);
  display.print(F("Volume"));
  display.fillTriangle(32, 38, 46, 32, 46, 44, SSD1306_WHITE);
  display.fillTriangle(121, 38, 107, 32, 107, 44, SSD1306_WHITE);
  display.setCursor(66, 32);
	// Display formatting
	if (volume < 10) {
		display.print("0");
	}
  display.println(volume);
  display.display();
}

void sendDFPlayerCommand(byte command, byte parameter1, byte parameter2) {
  commandBytes[3] = command;
  commandBytes[5] = parameter1;
  commandBytes[6] = parameter2;

  // Calculate the 16-bit checksum required by the DFPlayer
  unsigned int checksum = 0;
  for (int i = 1; i < 7; i++) {
    checksum += commandBytes[i];
  }
  checksum = -checksum;

  commandBytes[7] = highByte(checksum);
  commandBytes[8] = lowByte(checksum);

  // Send the clean 10-byte packet directly to the hardware pins
  Serial.write(commandBytes, 10);
}